#include <behaviors.dtsi>
#include <dt-bindings/zmk/keys.h>
#include <dt-bindings/zmk/bt.h>

/ {
  chosen {
    zmk,matrix_transform = &default_transform;
  };
};

#include "./core/config_3x5.h"

#define EN_PRONOUN_COMBOS // uncomment for pronoun combos

/ {
#include "./core/behaviors.dtsi"
#include "./core/macros.dtsi"
#include "./core/combos_3x5.dtsi"

        keymap {
        compatible = "zmk,keymap";
#include "./layers/3x5_alpha_HD-vv.dtsi"  // base (alpha) layer
#include "./layers/3x5_layers.dtsi"  // all other layers
    };
};